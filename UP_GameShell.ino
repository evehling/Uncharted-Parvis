//structure for gameplay--see gameplayex.mov for demo
#include <Arduboy2.h>
Arduboy2 arduboy;
# define HEIGHT 64
# define WIDTH 128

//general program variables
int gamestate = 0;

//Title screen things
const unsigned char title[] PROGMEM = {
  0x40, 0x80, 0x20, 0x0a, 0xc0, 0x84, 0x00, 0x0b, 
  0x18, 0x19, 0x07, 0x06, 0x7d, 0x62, 0x3f, 0x3b, 
  0x3f, 0x0c, 0x10, 0x7a, 0x7c, 0x49, 0xec, 0xe2, 
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  0x1a, 0x0f, 0x17, 0x2e, 0x28, 0x0c, 0x02, 0x00, 
  
};

void displayTitle() {
  arduboy.drawBitmap(0,0,title,WIDTH,HEIGHT,1);
  if (arduboy.justPressed(A_BUTTON)) {
    gamestate = 1;
  }
}
//GENERAL MENU THINGS
  //menu variables
  int menuCursorY = 23;
# define GAMEMODE 23
# define SETTINGS 38
# define CONTROLS 53
  int menustate = 0;


//menu image bitmap 
const unsigned char menu[] PROGMEM = {
  0x80, 0x80, 0x80, 0x90, 0x94, 0x18, 0x18, 0x58, 
  0xe0, 0xa0, 0x30, 0x00, 0x20, 0xa1, 0xe1, 0xc4, 
  0x86, 0x0f, 0x08, 0x18, 0x1c, 0x7c, 0xf4, 0xe6, 
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  0x00, 0x00, 0x00, 0x00, 0x00, 0x00, 0x00, 0x00, 
  
};

void drawMenu(){
  arduboy.drawBitmap(0,0,menu,WIDTH, HEIGHT,1);
  //arduboy.setCursor(45, 5);
  //arduboy.print("MENU");
  arduboy.setCursor(40, 20);
  arduboy.print("Game Mode");
  arduboy.setCursor(40, 35);
  arduboy.print("Settings");
  arduboy.setCursor(40, 50);
  arduboy.print("Controls");
  }
//moves and draws menu cursor
void menuCursor(){
    arduboy.drawCircle(5, menuCursorY, 3, WHITE);
    arduboy.drawCircle(5, menuCursorY, 1, BLACK);
    if (arduboy.justPressed(DOWN_BUTTON) and menuCursorY < 53) {
      menuCursorY += 15;
    }
    if (arduboy.justPressed(UP_BUTTON) and menuCursorY > 23) {
      menuCursorY -= 15;
    }
  }
//back button for menu
void menuBack(){
  if(arduboy.justPressed(B_BUTTON) and menustate>0){
    menustate=0;
    }
}

void menuSelection(){
  //for menu button selection
  if (arduboy.justPressed(A_BUTTON) and menuCursorY == GAMEMODE) {
      menustate = 1;
   }
   if (arduboy.justPressed(A_BUTTON) and menuCursorY == SETTINGS) {
      menustate = 2;
   }
   if(arduboy.justPressed(A_BUTTON) and menuCursorY == CONTROLS){
      menustate= 3;
   }
}

//controls bitmap 
const unsigned char controls[] PROGMEM = {
  0x00, 0x00, 0x00, 0x00, 0x00, 0x00, 0x00, 0x00, 
  0x00, 0x00, 0x00, 0x00, 0x00, 0x00, 0x00, 0x00, 
  0x00, 0x00, 0x00, 0x00, 0x00, 0x00, 0x00, 0x00, 
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  0x00, 0x00, 0x00, 0x00, 0x00, 0x00, 0x00, 0x00, 
  
};

  //nate
  int hits = 0;
  int luck = 0; //each level of luck uses different layer of black pixels frame to show damage, needs to do on botton of display list bc its the last overlay, then score
  int bullets = 100; //each press of A subtracts 1

  //gun sight
  int sightx = 0;
  int sighty = 0;

  //bullet coords + speed
  int bulletx = 0;
  int bullety = 0;
  int bulletspeed = 0;

  void setup() {
    arduboy.begin();
    srand(7 / 8);
    arduboy.setFrameRate(60);
    arduboy.clear();
  }
  /* #I'm kinda feeling two separate games bc the graphics might take up a lot of room, so maybe just gameplay + journal as an extra?
      A press>gamestate+=1, A=B press >> gamestate -=1 if gamestate !=0,or < the gameplay
      >>Main Screen: UNCHARTED: Magna Edition
        >>A to Begin
        >>play theme music
      >>Menu
        >>play theme music
        >>Controls
          >> Print button controls
            >>A to shoot, B to reload
            >>L/R for left/right movement
            >>Down to Duck behind wall
            >>Up to pause
        >>Sound Settings
          >>On
          >>Off
        >>Extras
          >>Nate's Journal
          >>play different song
      >> Gameplay
        >>play fighting song + sound effects
        >>If Mode ==Default:
          >>If nate takes 4 consecutive hits, display 'luck frame' (hits>=4,display
          >>Jungle Background
          >>Enemies randomly spawn
        >>If Mode==Journal
          >>Display journal
          >>LR to flip through pages
  */
  void loop() {
    if (!arduboy.nextFrame()) {
      return;
    }
    arduboy.clear();
    arduboy.pollButtons();
    switch (gamestate) {
      case 0:
        //add titlescreen graphics
        displayTitle();
      break;
      case 1: //MENU SCREEN----------------------------------------------------------------------
        switch (menustate) {
          case 0:
            drawMenu();
            //add some menu graphics, probably drake's ring
            menuCursor();
            //returns to title screen
            if (arduboy.justPressed(B_BUTTON) and menustate==0) {
              gamestate = 0;
            }
            menuSelection();
            break;
          case 1:
            //game mode
            arduboy.print("game mode: Classic Shootout/Nate's Journal");
            //later when u have the coordinates and fonts picked out, add another menu for selecting nate's journal or combat
            //replace the below code with menu selection later
            if (arduboy.justPressed(A_BUTTON)){
              gamestate = 2;
            }
            menuBack();
            break;
          case 2:
            //settings
            arduboy.print("settings");
            //write in sound settings once/if u add in any sound effects
            menuBack();
            break;
          case 3:
            //controls
            arduboy.drawBitmap(0,0,controls,WIDTH,HEIGHT,1);
            menuBack();
            break;
    }
      break;
      case 2://--GAME MODE----------------------------------------------------------------------
        //this is for game 
        arduboy.print("gameplay");
      break;
      case 3://-JOURNAL MODE-------------------------------------------------------------------
        //this is for journal if memory space
        arduboy.print("Nate's journal");
      break;
      case 4:
        //this is for losing
        arduboy.print("Play Again?");
        //A for yes, B to return to Menu
        if(arduboy.justPressed(A_BUTTON)){
          gamestate = 2;
        }
        if(arduboy.justPressed(B_BUTTON)){
          gamestate = 1;
        }
      
  }
  arduboy.display();
}
