//left off editing the shoot function and trying to figure out wtf is up with the arduboy

#include <Arduboy2.h>
Arduboy2 arduboy;

#define WIDTH 128
#define HEIGHT 64
//nate bitmap
const unsigned char nate[] PROGMEM = {
  0x00, 0x00, 0x00, 0x00, 0x00, 0x00, 0x00, 0x00, 
  0x00, 0x00, 0x00, 0x00, 0x00, 0x00, 0x00, 0x00, 
  0x00, 0x00, 0x00, 0x00, 0x00, 0x00, 0x00, 0x00, 
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  0x00, 0x00, 0x00, 0x00, 0x00, 0x00, 0x00, 0x00, 
  
};



int natestate = 0;
//temporary nate variables
int NATEX =0;
int NATEY = 0;

void drawNate(){
  //arduboy.drawRect(NATEX,NATEY,25,50,WHITE);
  arduboy.drawBitmap(NATEX,NATEY, nate, WIDTH,HEIGHT,1);
}
void moveNate(){
  if(arduboy.pressed(LEFT_BUTTON) and NATEX >= -20){
    NATEX -=1;
  }
  if(arduboy.pressed(RIGHT_BUTTON) and NATEX <= 20){
    NATEX +=1;
  }
  if(arduboy.justPressed(DOWN_BUTTON)){
    //nate crouches, so switch image
    NATEY = 15;
  }
  if(arduboy.justPressed(UP_BUTTON)){
    NATEY = 0;
  }
}
//shooting stuff

int bullets =100;
int shotx= NATEX;
int shoty= NATEY;
int shotSpeed = -2;

void shoot(){
  while(shoty >= 0){
    arduboy.drawLine(shotx-3, shoty-3,shotx,shoty,WHITE);
    shotx -=2;
    shoty -=2;
  }  
}

//badguy variables
int BGX = 0;
int BGY = 0;
int BGW = 7;
int BGH = 12;
void drawBadGuy(){
  arduboy.drawRect(BGX,BGY,BGW,BGH,WHITE);
}

void setup() {
  arduboy.boot();
  arduboy.clear();
  arduboy.setFrameRate(60);
  arduboy.display();
}

void loop() {
  if (!arduboy.nextFrame()){
    return;
  }
  arduboy.clear();
  arduboy.pollButtons();
  
  drawBadGuy();

  switch(natestate){
    case 0: //starting position, standing
      moveNate();
      if(arduboy.justPressed(A_BUTTON)){
        shoot();
        bullets -= 1;
        //shotx = NATEX;
        //nshoty = NATEY;

      }
      if(arduboy.justPressed(B_BUTTON)){
        natestate = 1;
       }
     break;
     case 1: //aiming gun
        //zoom in on bad guys and background, so I guess increase their size by a certain ratio? and increase their speed
       if(arduboy.justPressed(B_BUTTON)){
        natestate =0;
       }
      break;
    }
  drawNate();

  arduboy.display();
  
  /*background
    -leaves + trees, vines 
    -wall
  */
  /*Nate
    -1 standing image that shifts x and y coords slightly (to make him kind of breath)
    -zoomed in shot of his head and upper back for scope on gun
    -one ducking image that shifts x and y coords slightly
      -this is only time he can regain health
  */
  /*Gun 
    small circle for zoomed in shots
    */
  /*#Shooting
   *need random spread for bullet direction
   *Bullet counter at top left
   *bullet icon image
   *
   */
  /* Luck Counter
   *  (not sure if I want a physical bar yet but we'll see)
   *  timer variable
   *    -if timer reaches 2 and luck counter isn't increasing, decrease luck counter by 2
   * 6 consecutive shots and game ends (change game state)
   * 3 shots; mild overlay in corners and on bottom
   * 4 shots; overlay along entire bottom and corners
   * 5 shots; black obscures most of bottom and corners
   */
   
    
}
